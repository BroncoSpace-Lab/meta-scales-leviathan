## conf/layer.conf
```bitbake
# We have a conf and classes directory, add to BBPATH
BBPATH .= ":${LAYERDIR}"

# We have recipes-* directories, add to BBFILES
BBFILES += "${LAYERDIR}/recipes-*/*/*.bb \
            ${LAYERDIR}/recipes-*/*/*.bbappend"

BBFILE_COLLECTIONS += "meta-scales-leviathan"
BBFILE_PATTERN_meta-scales-leviathan = "^${LAYERDIR}/"
BBFILE_PRIORITY_meta-scales-leviathan = "999"

LAYERDEPENDS_meta-scales-leviathan = "core"
LAYERSERIES_COMPAT_meta-scales-leviathan = "scarthgap"
```
